#pragma once
#include <Arduino.h>
#include <Adafruit_GFX.h>
#include <Adafruit_SSD1306.h>
extern Adafruit_SSD1306 display;
extern const unsigned char* const* currentFaceFrames;
extern uint8_t currentFaceFrameCount;
extern uint8_t currentFaceFrameIndex;
void updateFaceBitmap(const unsigned char* bitmap);
const int PD_FRAME_MS = 70;
const float PD_SPIN_STEP = 0.08f;
enum PlanetDisplayType : int8_t { PD_NONE = -1, PD_EARTH = 0, PD_MARS = 1, PD_MOON = 2, PD_JUPITER = 3 };
const unsigned char PD_EARTH_MAP[] PROGMEM = {
  0x00, 0x00, 0x00, 0x00, 0x00, 0x00, 0x00, 0x00, 0x00, 0x00, 0x00, 0x00, 0x00, 0x00, 0x00, 0x00,
  0x00, 0x00, 0x00, 0x00, 0x00, 0x00, 0x00, 0x00, 0x00, 0x00, 0x00, 0x00, 0x00, 0x00, 0x00, 0x00,
  0x00, 0x00, 0x00, 0x00, 0x00, 0x00, 0x00, 0x00, 0x00, 0x00, 0x00, 0x00, 0x00, 0x00, 0x00, 0x00,
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  0xFF, 0xFF, 0xFF, 0xFF, 0xFF, 0xFF, 0xFF, 0xFF, 0xFF, 0xFF, 0xFF, 0xFF, 0xFF, 0xFF, 0xFF, 0xFF
};
const unsigned char PD_MOON_SRC[] PROGMEM = {
  0x00, 0x00, 0x00, 0x00, 0x00, 0x00, 0x00, 0x00, 0x00, 0x00, 0x00, 0x00, 0x00, 0x00, 0x00, 0x00, 0x00, 0x00, 0x00, 0x00, 0x00, 0x00,
  0x00, 0x00, 0x00, 0x00, 0x00, 0x00, 0x00, 0x00, 0x00, 0x00, 0x00, 0x00, 0x00, 0x00, 0x00, 0x00, 0x00, 0x00, 0x00, 0x00, 0x00, 0x00,
  0x00, 0x00, 0x00, 0x00, 0x00, 0x00, 0x00, 0x00, 0x00, 0x00, 0x00, 0x00, 0x00, 0x00, 0x00, 0x00, 0x00, 0x00, 0x00, 0x00, 0x00, 0x00,
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  0x00, 0x00, 0x00, 0x00, 0x00, 0x00, 0x00, 0x00, 0x00, 0x00, 0x00, 0x00, 0x00, 0x00, 0x00, 0x00, 0x00, 0x00, 0x00, 0x00, 0x00, 0x00
};
const unsigned char PD_MARS_SRC[] PROGMEM = {
  0x00, 0x00, 0x00, 0x00, 0x00, 0x00, 0x00, 0x00, 0x00, 0x00, 0x00, 0x1F, 0x80, 0x00, 0x00, 0x00, 0x00, 0x00, 0x00, 0x00, 0x00, 0x00,
  0x00, 0x00, 0x00, 0x00, 0x00, 0x00, 0x00, 0x00, 0x00, 0x00, 0x00, 0x1F, 0x00, 0x00, 0x00, 0x00, 0x00, 0x00, 0x00, 0x00, 0x00, 0x00,
  0x00, 0x00, 0x00, 0x00, 0x00, 0x00, 0x00, 0x00, 0x00, 0x00, 0x00, 0x38, 0x00, 0x00, 0x00, 0x00, 0x00, 0x00, 0x00, 0x00, 0x00, 0x00,
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  0x00, 0x00, 0x00, 0x00, 0x00, 0x00, 0x00, 0x00, 0x00, 0x00, 0x00, 0x00, 0x00, 0x00, 0x00, 0x00, 0x00, 0x00, 0x00, 0x00, 0x00, 0x00
};
const uint8_t PD_BAYER4[4][4] = {{0, 8, 2, 10}, {12, 4, 14, 6}, {3, 11, 1, 9}, {15, 7, 13, 5}};
const float PD_DEG = 0.0174533f;
const float PD_JUP_BANDS[][2] = {
  { 62, 1}, { 50, 2}, { 40, 1}, { 31, 2}, { 24, 1},
  { 17, 3}, {  7, 0}, { -7, 3}, {-20, 0}, {-27, 3},
  {-35, 1}, {-45, 2}, {-58, 1}, {-68, 2}, {-91, 1}
};
const int PD_NUM_JBANDS = sizeof(PD_JUP_BANDS) / sizeof(PD_JUP_BANDS[0]);
static PlanetDisplayType pdType = PD_NONE;
static float pdSpin = 0;
static unsigned long pdLastMs = 0;
inline float pdWrapPi(float a) {
  while (a > PI) a -= 2 * PI;
  while (a < -PI) a += 2 * PI;
  return a;
}
inline bool pdTexel(PlanetDisplayType type, int sx, int sy, float lat, float lon) {
  if (type == PD_EARTH) {
    int col = (int)((lon / (2 * PI) + 0.5f) * 128);
    col = ((col % 128) + 128) % 128;
    int row = (int)((0.5f - lat / PI) * 64);
    if (row < 0) row = 0;
    if (row > 63) row = 63;
    uint8_t b = pgm_read_byte(&PD_EARTH_MAP[row * 16 + col / 8]);
    return b & (0x80 >> (col % 8));
  }
  if (type == PD_MARS || type == PD_MOON) {
    float L = pdWrapPi(lon);
    if (L > PI / 2) L = PI - L;
    else if (L < -PI / 2) L = -PI - L;
    float scale = (type == PD_MARS) ? 87.0f : 84.0f;
    int u = (int)(88.0f + cosf(lat) * sinf(L) * scale + 0.5f);
    int v = (int)(88.0f - sinf(lat) * scale + 0.5f);
    const unsigned char* src = (type == PD_MARS) ? PD_MARS_SRC : PD_MOON_SRC;
    int n = 0;
    for (int dy = -1; dy <= 1; dy++) {
      for (int dx = -1; dx <= 1; dx++) {
        int xx = u + dx, yy = v + dy;
        if (xx < 0 || xx > 175 || yy < 0 || yy > 175) continue;
        if (pgm_read_byte(&src[yy * 22 + (xx >> 3)]) & (0x80 >> (xx & 7))) n++;
      }
    }
    if (type == PD_MARS) return n >= 2;
    float g = (n / 9.0f - 0.22f) / 0.56f;
    return g > (PD_BAYER4[sy & 3][sx & 3] + 0.5f) / 16.0f;
  }
  float L = pdWrapPi(lon);
  {
    float dl = pdWrapPi(L - 1.0f) * cosf(lat) / 0.30f;
    float dt = (lat + 22.0f * PD_DEG) / 0.15f;
    float e = dl * dl + dt * dt;
    if (e < 0.35f) return true;
    if (e < 1.0f) return false;
    if (e < 1.8f) return true;
  }
  float d = lat / PD_DEG + 2.2f * sinf(L * 4.0f + lat * 2.0f) + 1.2f * sinf(L * 9.0f);
  int level = (int)PD_JUP_BANDS[PD_NUM_JBANDS - 1][1];
  for (int i = 0; i < PD_NUM_JBANDS; i++) {
    if (d > PD_JUP_BANDS[i][0]) { level = (int)PD_JUP_BANDS[i][1]; break; }
  }
  return level >= 2;
}
inline void pdDrawSphere(PlanetDisplayType type, float spin) {
  const int cx = 64, cy = 32, r = 30;
  if (type != PD_MOON) display.drawCircle(cx, cy, r + 1, SSD1306_WHITE);
  for (int py = -r; py <= r; py++) {
    for (int pxl = -r; pxl <= r; pxl++) {
      float x = pxl / (float)r;
      float y = py / (float)r;
      float d2 = x * x + y * y;
      if (d2 > 1.0f) continue;
      float z = sqrtf(1.0f - d2);
      float lat = asinf(-y);
      float lon = atan2f(x, z) - spin;
      if (pdTexel(type, cx + pxl, cy + py, lat, lon)) display.drawPixel(cx + pxl, cy + py, SSD1306_WHITE);
    }
  }
}
inline bool planetDisplayActive() { return pdType != PD_NONE; }
inline void planetDisplayUpdate() {
  if (pdType == PD_NONE) return;
  unsigned long now = millis();
  if (now - pdLastMs < (unsigned long)PD_FRAME_MS) return;
  pdLastMs = now;
  display.clearDisplay();
  pdDrawSphere(pdType, pdSpin);
  display.display();
  pdSpin += PD_SPIN_STEP;
  if (pdSpin > 2 * PI) pdSpin -= 2 * PI;
}
bool planetDisplayStart(const char* name) {
  PlanetDisplayType t = PD_NONE;
  if (strcmp(name, "earth") == 0) t = PD_EARTH;
  else if (strcmp(name, "mars") == 0) t = PD_MARS;
  else if (strcmp(name, "moon") == 0) t = PD_MOON;
  else if (strcmp(name, "jupiter") == 0) t = PD_JUPITER;
  if (t == PD_NONE) return false;
  pdType = t;
  pdSpin = 0;
  pdLastMs = millis() - PD_FRAME_MS;
  planetDisplayUpdate();
  return true;
}
void planetDisplayStop() {
  if (pdType == PD_NONE) return;
  pdType = PD_NONE;
  if (currentFaceFrames != nullptr && currentFaceFrameCount > 0 && currentFaceFrames[currentFaceFrameIndex] != nullptr) {
    updateFaceBitmap(currentFaceFrames[currentFaceFrameIndex]);
  } else {
    display.clearDisplay();
    display.display();
  }
}